## device/cm5-os/br2-external/Config.in
```kconfig
menu "CM5 Media OS"
source "$BR2_EXTERNAL_CM5_MEDIA_PATH/package/cm5-home/Config.in"
endmenu
```

## device/cm5-os/br2-external/package/cm5-home/Config.in
```kconfig
config BR2_PACKAGE_CM5_HOME
	bool "cm5-home"
	# qt6multimedia selects qt6base-gui and qt6base-network.
	depends on BR2_PACKAGE_QT6MULTIMEDIA
	select BR2_PACKAGE_QT6DECLARATIVE
	select BR2_PACKAGE_QT6DECLARATIVE_QUICK
	help
	  Retro Arcade Jellyfin Qt Quick media client.

comment "cm5-home needs qt6multimedia"
	depends on !BR2_PACKAGE_QT6MULTIMEDIA
```
